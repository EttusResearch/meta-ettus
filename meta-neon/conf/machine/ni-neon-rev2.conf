## meta-neon/conf/machine/ni-neon-rev2.conf
```bitbake
#@TYPE: Machine
#@Name: Ettus Research Neon.
#@DESCRIPTION: Machine configuration for the Ettus Research Neon Rev2 Software Radio.

require conf/machine/ni-neon.inc

KERNEL_DEVICETREE_ni-neon-rev2 = "\
                                  zynq-ni-neon-rev1.dtb \
                                 "


PREFERRED_VERSION_u-boot = "2019.07"
UBOOT_MACHINE_ni-neon-rev2 = "ni_neon_rev2_defconfig"

MACHINE_FEATURES_append_ni-neon-rev2 = " tpm"
```

## meta-neon/conf/machine/ni-neon.inc
```bitbake
require conf/machine/ni-zynq.inc

MACHINEOVERRIDES = "ni-neon:${MACHINE}"

MACHINE_FEATURES = "vfat ethernet usbhost ext2 rtc"

SERIAL_CONSOLES ?= "115200;ttyPS0"
SERIAL_CONSOLES_CHECK = "${SERIAL_CONSOLES}"

UBOOT_SUFFIX_ni-neon = "img"
UBOOT_ENTRYPOINT_ni-neon = "0000000"
UBOOT_LOADADDRESS_ni-neon = "0000000"
UBOOT_BINARY_ni-neon = "u-boot.${UBOOT_SUFFIX}"
SPL_BINARY_ni-neon = "spl/boot.bin"


IMAGE_BOOT_FILES ?= "boot.bin ${UBOOT_BINARY}"

KERNEL_CLASSES += "kernel-fitimage"
KERNEL_IMAGETYPE = "fitImage"
KERNEL_DEFCONFIG ?= "ni_neon_defconfig"

PREFERRED_VERSION_linux-yocto = "4.18.%"

MACHINE_ESSENTIAL_EXTRA_RRECOMMENDS = " \
                             kernel-image \
                             kernel-modules \
                            "

MACHINE_EXTRA_RRECOMMENDS = " \
                             mpmd-tools \
                             eeprom-hostname-systemd \
                             gpsd \
                             gpsd-gpsctl \
                             gpsd-machine-conf \
                             haveged \
                            "

IMAGE_INSTALL_append_ni-neon = " kernel-image \
                                linux-firmware-ni-neon \
                               "

do_image_wic[depends] += " \
    u-boot:do_deploy \
    "
```

## meta-sulfur/conf/machine/ni-sulfur-rev10.conf
```bitbake
require conf/machine/ni-sulfur-rev6.conf

# Note: machine "ni-sulfur-rev6" can also be used for newer versions on n310 motherboard
# ("sulfur") or n300 motherboard ("phosphorus") if the only change is an updated MCU
# firmware. The "dt_compat" ("devicetree compatible") number stored in the eeprom is
# used to generate the string "variant" in u-boot which selects the device tree that
# is used to boot the device. "dt_compat" can be a smaller number than the current
# hardware revision if the device tree is compatible.
```

## meta-sulfur/conf/machine/ni-sulfur-rev3.conf
```bitbake
#@TYPE: Machine
#@Name: Ettus Research Sulfur.
#@DESCRIPTION: Machine configuration for the Ettus Research Sulfur Rev2 Software Radio.

require conf/machine/ni-sulfur.inc

KERNEL_DEVICETREE_ni-sulfur-rev3 = "zynq-ni-sulfur-rev3.dtb zynq-ni-eiscat.dtb zynq-ni-magnesium.dtb"

UBOOT_MACHINE_ni-sulfur-rev3 = "ni_sulfur_rev3_defconfig"
```

## meta-sulfur/conf/machine/ni-sulfur-rev5.conf
```bitbake
#@TYPE: Machine
#@Name: Ettus Research Sulfur.
#@DESCRIPTION: Machine configuration for the Ettus Research Sulfur Rev5 Software Radio.

require conf/machine/ni-sulfur.inc

KERNEL_DEVICETREE_ni-sulfur-rev5 = "\
                                    zynq-ni-sulfur-rev3.dtb \
                                    zynq-ni-sulfur-rev4.dtb \
                                    zynq-ni-sulfur-rev5.dtb \
                                    zynq-ni-sulfur-rev3-eiscat-rev1.dtb \
                                    zynq-ni-sulfur-rev3-eiscat-rev2.dtb \
                                    zynq-ni-sulfur-rev4-magnesium-rev2.dtb \
                                    zynq-ni-sulfur-rev4-magnesium-rev3.dtb \
                                    zynq-ni-sulfur-rev5-magnesium-rev2.dtb \
                                    zynq-ni-sulfur-rev5-magnesium-rev3.dtb \
                                    zynq-ni-sulfur-rev4-rhodium-rev0.dtb \
                                    zynq-ni-sulfur-rev5-rhodium-rev0.dtb \
                                    zynq-ni-phosphorus-rev4.dtb \
                                    zynq-ni-phosphorus-rev4-magnesium-rev2.dtb \
                                    zynq-ni-phosphorus-rev4-magnesium-rev3.dtb \
                                    "

UBOOT_MACHINE_ni-sulfur-rev5 = "ni_sulfur_rev3_defconfig"

MACHINE_FEATURES_append_ni-sulfur-rev5 = " tpm"
```

## meta-sulfur/conf/machine/ni-sulfur-rev6.conf
```bitbake
#@TYPE: Machine
#@Name: Ettus Research Sulfur.
#@DESCRIPTION: Machine configuration for the Ettus Research Sulfur Rev6+ (currently up to rev. 10)  Software Radio.

# Note: machine "ni-sulfur-rev6-mender" can also be used for newer versions on n310 motherboard
# ("sulfur") or n300 motherboard ("phosphorus") if the only change is an updated MCU
# firmware. The "dt_compat" ("devicetree compatible") number stored in the eeprom is
# used to generate the string "variant" in u-boot which selects the device tree that
# is used to boot the device. "dt_compat" can be a smaller number than the current
# hardware revision if the device tree is compatible.

require conf/machine/ni-sulfur.inc

MACHINEOVERRIDES =. "ni-sulfur-rev6:"

KERNEL_DEVICETREE_ni-sulfur-rev6 = "\
                                    zynq-ni-sulfur-rev3.dtb \
                                    zynq-ni-sulfur-rev3-eiscat-rev1.dtb \
                                    zynq-ni-sulfur-rev3-eiscat-rev2.dtb \
                                    zynq-ni-sulfur-rev4.dtb \
                                    zynq-ni-sulfur-rev4-magnesium-rev2.dtb \
                                    zynq-ni-sulfur-rev4-magnesium-rev3.dtb \
                                    zynq-ni-sulfur-rev4-rhodium-rev0.dtb \
                                    zynq-ni-sulfur-rev5.dtb \
                                    zynq-ni-sulfur-rev5-magnesium-rev2.dtb \
                                    zynq-ni-sulfur-rev5-magnesium-rev3.dtb \
                                    zynq-ni-sulfur-rev5-rhodium-rev0.dtb \
                                    zynq-ni-sulfur-rev6.dtb \
                                    zynq-ni-sulfur-rev6-magnesium-rev2.dtb \
                                    zynq-ni-sulfur-rev6-magnesium-rev3.dtb \
                                    zynq-ni-sulfur-rev6-magnesium-rev4.dtb \
                                    zynq-ni-sulfur-rev6-rhodium-rev0.dtb \
                                    zynq-ni-phosphorus-rev4.dtb \
                                    zynq-ni-phosphorus-rev4-magnesium-rev2.dtb \
                                    zynq-ni-phosphorus-rev4-magnesium-rev3.dtb \
                                    zynq-ni-phosphorus-rev4-magnesium-rev4.dtb \
                                    zynq-ni-phosphorus-rev6.dtb \
                                    zynq-ni-phosphorus-rev6-magnesium-rev2.dtb \
                                    zynq-ni-phosphorus-rev6-magnesium-rev3.dtb \
                                    zynq-ni-phosphorus-rev6-magnesium-rev4.dtb \
                                    "

UBOOT_MACHINE_ni-sulfur-rev6 = "ni_sulfur_rev3_defconfig"

MACHINE_FEATURES_append_ni-sulfur-rev6 = " tpm"
```

## meta-sulfur/conf/machine/ni-sulfur.inc
```bitbake
require conf/machine/ni-zynq.inc

MACHINEOVERRIDES = "ni-sulfur:${MACHINE}"

MACHINE_FEATURES = "vfat ethernet usbhost ext2 rtc"

SERIAL_CONSOLES ?= "115200;ttyPS0"
SERIAL_CONSOLES_CHECK = "${SERIAL_CONSOLES}"

UBOOT_SUFFIX_ni-sulfur = "img"
UBOOT_ENTRYPOINT = "0000000"
UBOOT_LOADADDRESS = "0000000"
UBOOT_BINARY_ni-sulfur = "u-boot.${UBOOT_SUFFIX}"
SPL_BINARY_ni-sulfur = "spl/boot.bin"

IMAGE_BOOT_FILES ?= "boot.bin ${UBOOT_BINARY}"

KERNEL_CLASSES += "kernel-fitimage"
KERNEL_IMAGETYPE = "fitImage"
KERNEL_DEFCONFIG ?= "ni_sulfur_defconfig"

PREFERRED_VERSION_linux-yocto = "4.18.%"

MACHINE_ESSENTIAL_EXTRA_RRECOMMENDS = " \
                             kernel-image \
                             kernel-modules \
                             linux-firmware-ni-sulfur \
                             linux-firmware-ni-magnesium \
                             linux-firmware-adi-mykonos \
                             linux-firmware-ni-rhodium \
"

MACHINE_EXTRA_RRECOMMENDS = " \
                             mpmd-tools \
                             eeprom-hostname-systemd \
                             gpsd \
                             gpsd-gpsctl \
                             gpsd-machine-conf \
                            "

IMAGE_INSTALL_append_ni-sulfur = " kernel-image"

PREFERRED_VERSION_u-boot = "2018.07"
```

## meta-titanium/conf/layer.conf
```bitbake
# We have a conf and classes directory, add to BBPATH
BBPATH .= ":${LAYERDIR}"

# We have recipes-* directories, add to BBFILES
BBFILES += "${LAYERDIR}/recipes-*/*/*.bb \
            ${LAYERDIR}/recipes-*/*/*.bbappend"

BBFILE_COLLECTIONS += "meta-titanium-layer"
BBFILE_PATTERN_meta-titanium-layer = "^${LAYERDIR}/"
BBFILE_PRIORITY_meta-titanium-layer = "6"

LAYERSERIES_COMPAT_meta-titanium-layer = "zeus"
```

## meta-titanium/conf/local.conf.sample
```bitbake
BBMULTICONFIG = "ni-titanium-ec zynqmp-pmu ni-titanium"
MACHINE ??= "ni-titanium-rev2"
DISTRO = "Alchemy"
INHERIT_remove = "uninative"
```

## meta-titanium/conf/machine/ni-titanium-ec.inc
```bitbake
require conf/machine/include/stm32f4x.inc

MACHINEOVERRIDES = "ni-titanium-ec:${MACHINE}"
```

## meta-titanium/conf/machine/ni-titanium-rev2.conf
```bitbake
include ni-titanium.inc

UBOOT_MACHINE = "ni_x410_rev2_defconfig"

WKS_FILE ?= "ni-titanium-rev2.wks"
```

## meta-titanium/conf/machine/ni-titanium-rev3.conf
```bitbake
include ni-titanium.inc

UBOOT_MACHINE = "ni_x410_rev3_defconfig"

WKS_FILE ?= "ni-titanium-rev4.wks"
```

## meta-titanium/conf/machine/ni-titanium-rev4.conf
```bitbake
include ni-titanium.inc

UBOOT_MACHINE = "ni_x410_rev4_defconfig"

WKS_FILE ?= "ni-titanium-rev4.wks"
```

## meta-titanium/conf/machine/ni-titanium-rev5.conf
```bitbake
include ni-titanium.inc

UBOOT_MACHINE = "ni_x410_rev5_defconfig"

WKS_FILE ?= "ni-titanium-rev5.wks"
```

## meta-titanium/conf/machine/ni-titanium.inc
```bitbake
PREFERRED_PROVIDER_virtual/kernel ?= "linux-x4xx"

require conf/machine/ni-zynqmp.inc

MACHINEOVERRIDES = "zynqmp:ni-titanium:${MACHINE}"
MACHINE_FEATURES = "rtc ethernet ext2 ext3 vfat usbhost"

UBOOT_SUFFIX_zynqmp ?= "itb"
UBOOT_BINARY ?= "u-boot.${UBOOT_SUFFIX}"
UBOOT_ELF_aarch64 ?= "u-boot.elf"

UBOOT_LOADADDRESS = "0x200000"
UBOOT_ENTRYPOINT = "0x200000"
UBOOT_DTB_LOADADDRESS = "0x70000"
UBOOT_DTBO_LOADADDRESS = "0x79000"

SPL_BINARY ?= "spl/boot.bin"
PREFERRED_VERSION_u-boot ?= "2020.10"

SERIAL_CONSOLES ?= "115200;ttyPS0"
SERIAL_CONSOLES_CHECK ?= "${SERIAL_CONSOLES}"

KERNEL_DEVICETREE_ni-titanium ?= "\
	ni/x410-rev2.dtb \
	ni/x410-rev3.dtb \
	ni/x410-rev4.dtb \
	ni/x410-rev5.dtb \
	ni/x410-rev6.dtb \
	ni/x410-rev7.dtb \
	ni/x4xx-db0-0x4001-rev1.dtbo \
	ni/x4xx-db1-0x4001-rev1.dtbo \
	ni/x4xx-dioaux-0x4003-rev1.dtbo \
	ni/x4xx-clkaux-0x4004-rev1.dtbo \
	ni/x4xx-clkaux-0x4005-rev1.dtbo \
	ni/x4xx-clkaux-0x4004-rev2.dtbo \
	ni/x4xx-clkaux-0x4005-rev2.dtbo \
	ni/x4xx-db0-0x4006-rev1.dtbo \
	ni/x4xx-db1-0x4006-rev1.dtbo \
	ni/x4xx-db0-db-flash.dtbo \
	ni/x4xx-db1-db-flash.dtbo \
"

IMAGE_BOOT_FILES ?= "boot.bin ${UBOOT_BINARY}"
PMU_FIRMWARE_DEPLOY_DIR ?= "${TOPDIR}/tmp-xilinx/deploy/images/zynqmp-pmu"
PMU_FIRMWARE_IMAGE_NAME ?= "pmu-firmware-zynqmp-pmu"

KERNEL_CLASSES += "kernel-fitimage"
KERNEL_IMAGETYPE = "fitImage"
INITRAMFS_IMAGE = "manufacturing-image"
INITRAMFS_IMAGE_BUNDLE = "1"

EXTRA_IMAGEDEPENDS_append_ni-titanium = " \
                                        virtual/bootloader \
                                        arm-trusted-firmware \
                                        "

MACHINE_ESSENTIAL_EXTRA_RRECOMMENDS = " \
                             kernel-image \
                             kernel-devicetree \
                             kernel-modules \
          "

MACHINE_EXTRA_RRECOMMENDS = " \
                             eeprom-hostname-systemd \
                             gpsd-machine-conf \
                             haveged \
                             ledctrl \
                             linux-firmware-ni-titanium \
			     mmc-utils \
			     uhd-cpld-images \
          "

do_image_wic[depends] += " \
    u-boot:do_deploy \
    "

IMAGE_FSTYPES += "wic wic.bmap"
```
