## common/conf/layer.conf
```bitbake
# We have a conf directory, append it to BBPATH
BBPATH .= ":${LAYERDIR}"

# We have a recipes directory, add to BBFILES
BBFILES += "${LAYERDIR}/recipes*/*/*.bb ${LAYERDIR}/recipes*/*/*.bbappend"

BBFILE_COLLECTIONS += "ettus-common"
BBFILE_PRIORITY_ettus-common = "1"
BBFILE_PATTERN_ettus-common = "^${LAYERDIR}"
```

## conf/distro/Alchemy.conf
```bitbake
DISTRO_VERSION = "test"

DISTRO_FEATURES_append = " opengl x11"

PACKAGECONFIG_pn-gr-osmosdr = "uhd"
PACKAGECONFIG_pn-boost = "locale python"

PACKAGECONFIG_pn-systemd_append = " networkd timedated timesyncd logind resolved hostnamed"

DEFAULTTUNE_ettus-e3xx-sg1 = "armv7ahf-neon"
DEFAULTTUNE_ettus-e3xx-sg3 = "armv7ahf-neon"

PACKAGE_CLASSES ?= "package_ipk"

USER_CLASSES ?= "buildstats image-mklibs image-buildinfo"

DISTRO_FEATURES_append = " systemd"
DISTRO_FEATURES_BACKFILL_CONSIDERED = "sysvinit"

VIRTUAL-RUNTIME_init_manager = "systemd"
```

## conf/layer.conf
```bitbake
# We have a conf directory, prepend it to BBPATH
BBPATH =. "${LAYERDIR}:"

# We have a recipes directory, add to BBFILES
BBFILES += "${LAYERDIR}/recipes*/*/*.bb ${LAYERDIR}/recipes*/*/*.bbappend"

BBFILE_COLLECTIONS += "ettus-bsp"
BBFILE_PRIORITY_ettus-bsp = "8"
BBFILE_PATTERN_ettus-bsp = "^${LAYERDIR}/"
```

## conf/machine/ettus-e300.inc
```bitbake
#@TYPE: Machine
#@Name: Ettus Research E3XX.
#@DESCRIPTION: Machine configuration for the Ettus Research E3XX Software Radio.

require ettus-zynq.inc

MACHINEOVERRIDES = "ettus-e300:${MACHINE}"

MACHINE_FEATURES = "vfat ethernet alsa usbhost bluetooth ext2 wifi"

SERIAL_CONSOLE = "115200 ttyPS0"

UBOOT_BINARY_ettus-e300 = "u-boot.${UBOOT_SUFFIX}"

MACHINE_EXTRA_RRECOMMENDS = "kernel-modules acpid rtimulib rtimulib-conf \
                             e3xx-udev-rules \
                             gpsd gps-config gpsd-gpsctl gps-utils \
                            "

IMAGE_BOOT_FILES += "fpga.bin"
```

## conf/machine/ettus-e3xx-sg1.conf
```bitbake
require conf/machine/ettus-e300.inc

KERNEL_DEVICETREE_ettus-e3xx-sg1 = "zynq-e31x-1.dtb"
UBOOT_MACHINE_ettus-e3xx-sg1 = "zynq_e3xx_1_defconfig"

IMAGE_BOOT_FILES_append_ettus-e3xx-sg1 = " uImage-zynq-e31x-1.dtb"
```

## conf/machine/ettus-zynq.inc
```bitbake
#@TYPE: Machine
#@DESCRIPTION: Base configuration for the Ettus Research Zynq based products.

PREFERRED_PROVIDER_virtual/kernel ?= "linux-yocto"

include conf/machine/include/tune-zynq.inc
require conf/machine/include/machine-xilinx-default.inc
require conf/machine/include/machine-xilinx-board.inc

PREFERRED_PROVIDER_virtual/bootloader ?= "u-boot"

IMAGE_BOOT_FILES += "boot.bin"
```

## conf/machine/ni-sulfur-rev2.conf
```bitbake
#@TYPE: Machine
#@Name: Ettus Research Sulfur.
#@DESCRIPTION: Machine configuration for the Ettus Research Sulfur Rev3 Software Radio.

require conf/machine/ni-sulfur.inc

KERNEL_DEVICETREE_ni-sulfur-rev2 = "zynq-ni-sulfur-rev2.dtb"

UBOOT_MACHINE_ni-sulfur-rev2 = "ni_sulfur_rev2_defconfig"

MACHINE_FEATURES_append_ni-sulfur-rev2 = " tpm"
```

## conf/machine/ni-sulfur-rev3.conf
```bitbake
#@TYPE: Machine
#@Name: Ettus Research Sulfur.
#@DESCRIPTION: Machine configuration for the Ettus Research Sulfur Rev3 Software Radio.

require conf/machine/ni-sulfur.inc

KERNEL_DEVICETREE_ni-sulfur-rev3 = "zynq-ni-sulfur-rev3.dtb"

UBOOT_MACHINE_ni-sulfur-rev3 = "ni_sulfur_rev3_defconfig"

MACHINE_EXTRA_RRECOMMENDS_ni-sulfur-rev3 += "linux-firmware-ni-sulfur-rev3"
```

## conf/machine/ni-sulfur-rev4.conf
```bitbake
#@TYPE: Machine
#@Name: Ettus Research Sulfur.
#@DESCRIPTION: Machine configuration for the Ettus Research Sulfur Rev3 Software Radio.

require conf/machine/ni-sulfur.inc

KERNEL_DEVICETREE_ni-sulfur-rev4 = "zynq-ni-sulfur-rev5.dtb zynq-ni-sulfur-rev4.dtb zynq-ni-eiscat.dtb zynq-ni-magnesium.dtb"

UBOOT_MACHINE_ni-sulfur-rev4 = "ni_sulfur_rev3_defconfig"

MACHINE_FEATURES_append_ni-sulfur-rev4 = " tpm"
```

## conf/machine/ni-sulfur.inc
```bitbake
require ettus-zynq.inc

MACHINEOVERRIDES = "ni-sulfur:${MACHINE}"

MACHINE_FEATURES = "vfat ethernet usbhost ext2 rtc"

SERIAL_CONSOLE = "115200 ttyPS0"

UBOOT_BINARY_sulfur = "u-boot.${UBOOT_SUFFIX}"

MACHINE_EXTRA_RRECOMMENDS = "kernel-modules \
                             gpsd gpsd-gpsctl gps-utils \
                            "

KERNEL_CLASSES += "kernel-fitimage"
KERNEL_IMAGETYPE = "fitImage"
KERNEL_DEFCONFIG ?= "ni_sulfur_defconfig"

PREFERRED_VERSION_linux-yocto = "4.12.%"

MACHINE_EXTRA_RRECOMMENDS = " \
                             kernel-modules \
                             kernel-image \
                             linux-firmware-ni-sulfur \
                             linux-firmware-ni-magnesium \
			    "
```

## conf/machine/sulfur.conf
```bitbake
#@TYPE: Machine
#@Name: Ettus Research Sulfur.
#@DESCRIPTION: Machine configuration for the Ettus Research Sulfur Software Radio.

require ettus-zynq.inc

MACHINEOVERRIDES = "${MACHINE}"

MACHINE_FEATURES = "vfat ethernet alsa usbhost bluetooth ext2 wifi"

SERIAL_CONSOLE = "115200 ttyPS0"

UBOOT_BINARY_sulfur = "u-boot.${UBOOT_SUFFIX}"

MACHINE_EXTRA_RRECOMMENDS = "kernel-modules \
                             gpsd gpsd-gpsctl gps-utils \
                            "

KERNEL_CLASSES += "kernel-fitimage"
KERNEL_IMAGETYPE = "fitImage"
KERNEL_DEVICETREE = "zynq-ni-sulfur-rev3.dtb"

PREFERRED_VERSION_linux-yocto = "4.10.%"

UBOOT_MACHINE_sulfur = "ni_sulfur_rev3_defconfig"

MACHINE_EXTRA_RRECOMMENDS = " \
			kernel-modules \
			kernel-image \
			"
```

## conf/machine/usrp-e1xx.conf
```bitbake
#@TYPE: Machine
#@NAME: USRP E1XX machine
#@DESCRIPTION: Machine configuration for the USRP E1XX
TARGET_ARCH = "arm"

PREFERRED_PROVIDER_virtual/xserver = "xserver-xorg"
XSERVER = "xserver-xorg \
           xf86-input-evdev \
           xf86-input-mouse \
           xf86-video-omapfb \
           xf86-input-keyboard"

# Only has DVI connector for external screen
GUI_MACHINE_CLASS = "bigscreen"

SOC_FAMILY = "omap3"
TARGET_ARCH = "arm"

require conf/machine/include/tune-cortexa8.inc
# Increase this everytime you change something in the kernel
MACHINE_KERNEL_PR = "r1"

KERNEL_IMAGETYPE = "uImage"

UBOOT_ENTRYPOINT = "0x80008000"
UBOOT_LOADADDRESS = "0x80008000"

PREFERRED_PROVIDER_virtual/kernel = "linux-usrp-embedded"

IMAGE_FSTYPES = "tar.gz"

SERIAL_CONSOLE = "115200 ttyO2"

UBOOT_MACHINE = "omap3_overo_config"

# and sdio
MACHINE_FEATURES = "kernel26 screen usbgadget usbhost vfat alsa nfs"

module_autoload_usrp_e = "usrp_e"
```

## contrib/wks/sdimage-8G-env.wks
```
# short-description: Create SD card image with a boot partition
# long-description: Creates a partitioned SD card image. Boot files
# are located in the first vfat partition.

part --ondisk mmcblk --no-table --align 128 --size 256
part /boot --source bootimg-partition --ondisk mmcblk --fstype=vfat --label boot --active --align 4 --size 16
part / --source rootfs --ondisk mmcblk --fstype=ext4 --label root --align 4 --size 5500
```

## e100-bsp/conf/layer.conf
```bitbake
# We have a conf directory, append it to BBPATH
BBPATH .= ":${LAYERDIR}"

# We have a recipes directory, add to BBFILES
BBFILES += "${LAYERDIR}/recipes*/*/*.bb ${LAYERDIR}/recipes*/*/*.bbappend"

BBFILE_COLLECTIONS += "ettus-e100"
BBFILE_PRIORITY_ettus-e100 = "8"
BBFILE_PATTERN_ettus-e100 = "^${LAYERDIR}/"
```

## e100-bsp/conf/machine/ettus-e1xx.conf
```bitbake
#@TYPE: Machine
#@NAME: USRP E1XX machine
#@DESCRIPTION: Machine configuration for the USRP E1XX

PREFERRED_PROVIDER_virtual/xserver = "xserver-xorg"
XSERVER = "xserver-xorg \
           xf86-input-evdev \
           xf86-input-mouse \
           xf86-video-omapfb \
           xf86-input-keyboard"

require conf/machine/include/tune-cortexa8.inc

PREFERRED_PROVIDER_virtual/kernel ?= "linux-dummy"

SERIAL_CONSOLE = "115200 ttyO2"

UBOOT_MACHINE = "omap3_overo_config"

MACHINE_FEATURES = "usbgadget usbhost vfat alsa nfs"

module_autoload_usrp_e = "usrp_e"
```

## e200-bsp/conf/machine/ettus-e200.conf
```bitbake
#@TYPE: Machine
#@Name: Ettus Research E200.
#@DESCRIPTION: Machine configuration for the Ettus Research E200 Software Radio.

PREFERRED_PROVIDER_virtual/kernel ?= "linux-xlnx"

MACHINE_FEATURES = "vfat ethernet alsa usbhost bluetooth"

SERIAL_CONSOLE = "115200 ttyPS0"

include conf/machine/include/tune-zynq.inc

UBOOT_MACHINE = "zynq_zc70x_config"
```

## e300-bsp/conf/layer.conf
```bitbake
# We have a conf directory, prepend it to BBPATH
BBPATH =. "${LAYERDIR}:"

# We have a recipes directory, add to BBFILES
BBFILES += "${LAYERDIR}/recipes*/*/*.bb ${LAYERDIR}/recipes*/*/*.bbappend"

BBFILE_COLLECTIONS += "ettus-e300"
BBFILE_PRIORITY_ettus-e300 = "8"
BBFILE_PATTERN_ettus-e300 = "^${LAYERDIR}/"
```

## e300-bsp/conf/machine/ettus-e300.conf
```bitbake
#@TYPE: Machine
#@Name: Ettus Research E200.
#@DESCRIPTION: Machine configuration for the Ettus Research E200 Software Radio.

PREFERRED_PROVIDER_virtual/kernel ?= "linux-xlnx"
PREFERRED_VERSION_linux-xlnx ?= "3.14%"

MACHINE_FEATURES = "vfat ethernet alsa usbhost bluetooth ext2 wifi"

SERIAL_CONSOLE = "115200 ttyPS0"

include conf/machine/include/tune-zynq.inc
require conf/machine/include/machine-xilinx-default.inc
require conf/machine/include/machine-xilinx-board.inc

PREFERRED_PROVIDER_virtual/bootloader ?= "u-boot-xlnx"
PREFERRED_PROVIDER_virtual/boot-bin ?= "u-booti-spl-xlnx"

UBOOT_BINARY_ettus-e300 = "u-boot-dtb"

UBOOT_MACHINE = "zynq_zc70x_config"

MACHINE_DEVICETREE := "e300-devicetree.dts"

MACHINE_EXTRA_RRECOMMENDS = "kernel-modules acpid rtimulib rtimulib-conf"
 
UBOOT_ENV = "uEnv"
IMAGE_BOOT_FILES += "boot.bin fpga.bin uEnv.txt e300-devicetree.dtb"
```

## e300-bsp/conf/machine/ettus-e300.inc
```bitbake
#@TYPE: Machine
#@Name: Ettus Research E3XX.
#@DESCRIPTION: Machine configuration for the Ettus Research E3XX Software Radio.

MACHINEOVERRIDES = "ettus-e300:${MACHINE}"

PREFERRED_PROVIDER_virtual/kernel ?= "linux-xlnx"
PREFERRED_VERSION_linux-xlnx ?= "3.14%"

MACHINE_FEATURES = "vfat ethernet alsa usbhost bluetooth ext2 wifi"

SERIAL_CONSOLE = "115200 ttyPS0"

include conf/machine/include/tune-zynq.inc
require conf/machine/include/machine-xilinx-default.inc
require conf/machine/include/machine-xilinx-board.inc

PREFERRED_PROVIDER_virtual/bootloader ?= "u-boot"

UBOOT_BINARY_ettus-e300 = "u-boot.${UBOOT_SUFFIX}"

MACHINE_ESSENTIAL_EXTRA_RDEPENDS_append_ettus-e300 += "device-tree"

MACHINE_EXTRA_RRECOMMENDS = "kernel-modules acpid rtimulib rtimulib-conf \
                             e3xx-udev-rules \
                             gpsd gps-config gpsd-gpsctl gps-utils \
                            "
 
IMAGE_BOOT_FILES += "boot.bin"
```

## e300-bsp/conf/machine/ettus-e3xx-sg1.conf
```bitbake
require conf/machine/ettus-e300.inc

MACHINE_DEVICETREE_ettus-e3xx-sg1 = "uImage-zynq-e31x-1.dts uImage-zynq-e33x-1.dts uImage-zynq-e3xx-factory.dts"
UBOOT_MACHINE_ettus-e3xx-sg1 = "zynq_e3xx_1_defconfig"

IMAGE_BOOT_FILES_append_ettus-e3xx-sg1 = " uImage-zynq-e31x-1.dtb uImage-zynq-e33x-1.dtb  uImage-zynq-e3xx-factory.dtb"
```

## e300-bsp/conf/machine/ettus-e3xx-sg3.conf
```bitbake
require conf/machine/ettus-e300.inc

MACHINE_DEVICETREE_ettus-e3xx-sg3 = "uImage-zynq-e31x-3.dts uImage-zynq-e33x-3.dts uImage-zynq-e3xx-factory.dts"
UBOOT_MACHINE_ettus-e3xx-sg3 = "zynq_e3xx_3_defconfig"

IMAGE_BOOT_FILES_append_ettus-e3xx-sg3 = " uImage-zynq-e31x-3.dtb uImage-zynq-e33x-3.dtb  uImage-zynq-e3xx-factory.dtb"
```

## meta-alchemy/conf/layer.conf
```bitbake
# We have a conf and classes directory, add to BBPATH
BBPATH .= ":${LAYERDIR}"

# We have recipes-* directories, add to BBFILES
BBFILES += "${LAYERDIR}/recipes-*/*/*.bb \
            ${LAYERDIR}/recipes-*/*/*.bbappend"

BBFILE_COLLECTIONS += "meta-alchemy"
BBFILE_PATTERN_meta-alchemy = "^${LAYERDIR}/"
BBFILE_PRIORITY_meta-alchemy = "6"
```

## meta-e31x/conf/layer.conf
```bitbake
# We have a conf and classes directory, add to BBPATH
BBPATH .= ":${LAYERDIR}"

# We have recipes-* directories, add to BBFILES
BBFILES += "${LAYERDIR}/recipes-*/*/*.bb \
            ${LAYERDIR}/recipes-*/*/*.bbappend"

BBFILE_COLLECTIONS += "meta-e31x-layer"
BBFILE_PATTERN_meta-e31x-layer = "^${LAYERDIR}/"
BBFILE_PRIORITY_meta-e31x-layer = "6"

LAYERSERIES_COMPAT_meta-e31x-layer = "sumo"
```

## meta-e31x/conf/machine/ni-e31x-sg1.conf
```bitbake
#@TYPE: Machine
#@Name: NI Ettus Research E31x SG1
#@DESCRIPTION: Machine configuration for the NI Ettus Research E31x SG1

require conf/machine/ni-e31x.inc

KERNEL_DEVICETREE_ni-e31x-sg1 = "\
                                  zynq-ni-e31x-sg1.dtb \
                                 "

UBOOT_MACHINE_ni-e31x-sg1 = "ni_e31x_sg1_defconfig"
```

## meta-e31x/conf/machine/ni-e31x-sg3.conf
```bitbake
#@TYPE: Machine
#@Name: NI Ettus Research E31x SG3
#@DESCRIPTION: Machine configuration for the NI Ettus Research E31x SG3

require conf/machine/ni-e31x.inc

KERNEL_DEVICETREE_ni-e31x-sg3 = "\
                                  zynq-ni-e31x-sg3.dtb \
                                 "

UBOOT_MACHINE_ni-e31x-sg3 = "ni_e31x_sg3_defconfig"
```
