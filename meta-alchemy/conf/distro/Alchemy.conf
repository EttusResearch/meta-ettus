## meta-ettus-bsp/conf/machine/ni-titanium.inc
```bitbake
require conf/machine/ni-zynqmp.inc
require conf/machine/include/arm/armv8a/tune-cortexa53.inc

MACHINEOVERRIDES = "zynqmp:ni-common:ni-titanium:${MACHINE}"
MACHINE_FEATURES = "rtc ethernet ext2 ext3 vfat usbhost"

PREFERRED_PROVIDER_virtual/bootloader = "u-boot"

UBOOT_SUFFIX:zynqmp ?= "itb"
UBOOT_BINARY ?= "u-boot.${UBOOT_SUFFIX}"
UBOOT_ELF:aarch64 ?= "u-boot.elf"

UBOOT_LOADADDRESS = "0x200000"
UBOOT_ENTRYPOINT = "0x200000"
UBOOT_DTB_LOADADDRESS = "0x70000"
UBOOT_DTBO_LOADADDRESS = "0x7C000"

SPL_BINARY ?= "spl/boot.bin"
PREFERRED_VERSION_u-boot ?= "2026.01%"

PREFERRED_PROVIDER_virtual/arm-trusted-firmware = "arm-trusted-firmware"
# TODO: check why newer versions of arm-trusted-firmware do not work:
# with newer versions than 2.6-xilinx-v2022.2+git, U-Boot SPL (boot.bin)
# is loaded but U-Boot (u-boot.itb) is not
PREFERRED_VERSION_arm-trusted-firmware = "2.6-xilinx-v2022.2+git"
# PREFERRED_VERSION_arm-trusted-firmware = "2.8-xilinx-v2023.1+git"

SERIAL_CONSOLES ?= "115200;ttyPS0"
SERIAL_CONSOLES_CHECK ?= "${SERIAL_CONSOLES}"

KERNEL_DEVICETREE:ni-titanium ?= "\
	ni/x410-rev2.dtb \
	ni/x410-rev3.dtb \
	ni/x410-rev4.dtb \
	ni/x410-rev5.dtb \
	ni/x410-rev6.dtb \
	ni/x410-rev7.dtb \
	ni/x4xx-db0-0x4001-rev1.dtbo \
	ni/x4xx-db1-0x4001-rev1.dtbo \
	ni/x4xx-dioaux-0x4003-rev1.dtbo \
	ni/x4xx-clkaux-0x4004-rev1.dtbo \
	ni/x4xx-clkaux-0x4005-rev1.dtbo \
	ni/x4xx-clkaux-0x4004-rev2.dtbo \
	ni/x4xx-clkaux-0x4005-rev2.dtbo \
	ni/x4xx-db0-0x4006-rev1.dtbo \
	ni/x4xx-db1-0x4006-rev1.dtbo \
	ni/x4xx-db0-db-flash.dtbo \
	ni/x4xx-db1-db-flash.dtbo \
"
FIT_CONF_PREFIX = "conf@ni_"

IMAGE_BOOT_FILES ?= "boot.bin ${UBOOT_BINARY} ${KERNEL_IMAGETYPE}"
PMU_FIRMWARE_DEPLOY_DIR ?= "${TOPDIR}/tmp-xilinx/deploy/images/zynqmp-pmu"
PMU_FIRMWARE_IMAGE_NAME ?= "pmu-firmware-zynqmp-pmu"

KERNEL_CLASSES += "kernel-fitimage"
KERNEL_IMAGETYPE = "fitImage"
INITRAMFS_IMAGE = "manufacturing-image"
# INITRAMFS_IMAGE_BUNDLE = "1"

MACHINE_ESSENTIAL_EXTRA_RDEPENDS += " \
                             kernel-image \
                             kernel-devicetree \
                             watchdog \
                             usrp-firmware \
                            "

MACHINE_ESSENTIAL_EXTRA_RRECOMMENDS = " \
                             kernel-image \
                             kernel-devicetree \
                             kernel-modules \
                             usrp-firmware \
          "

MACHINE_EXTRA_RRECOMMENDS = " \
                             eeprom-hostname-systemd \
                             gpsd-machine-conf \
                             haveged \
                             ledctrl \
			     mmc-utils \
			     uhd-cpld-images \
                             udev-machine-conf \
          "

do_image_wic[depends] += " \
    u-boot:do_deploy \
    "

# On non-Mender devices, build "wic.xz" and "wic.bmap"
# On Mender enabled devices build "sdimg.bz2" (instead of "sdimg") and "sdimg.bmap"
IMAGE_FSTYPES += "${@bb.utils.contains('MENDER_FEATURES', 'mender-image-sd', ' sdimg.bz2', ' wic.bz2 wic.bmap', d)} tar.xz"
IMAGE_FSTYPES:remove = "${@bb.utils.contains('MENDER_FEATURES', 'mender-image-sd', ' sdimg', '', d)}"
```

## meta-mender-sulfur/conf/machine/ni-sulfur-mender.inc
```bitbake
MACHINEOVERRIDES =. "ni-sulfur-mender:"

# 16GB SD card with some wiggle room for smaller cards
MENDER_STORAGE_TOTAL_SIZE_MB = "15180"
MENDER_DATA_PART_SIZE_MB = "128"
MENDER_BOOT_PART_SIZE_MB = "16"
MENDER_STORAGE_DEVICE = "/dev/mmcblk0"

# force a fixed partitioning (Mender default values as of OE sumo release)
MENDER_PARTITIONING_OVERHEAD_KB="32768"
MENDER_PARTITION_ALIGNMENT="8388608"
MENDER_RESERVED_SPACE_BOOTLOADER_DATA="16777216"

MENDER_FEATURES_ENABLE:append:ni-sulfur-mender = " mender-uboot mender-image mender-systemd mender-image-sd"
MENDER_FEATURES_DISABLE:append:ni-sulfur-mender = " mender-grub mender-image-uefi"

IMAGE_INSTALL:append = " mender-migrate-configuration mender-is-mender-update"
PACKAGECONFIG:remove = "split-mender-config"
MENDER_PERSISTENT_CONFIGURATION_VARS = "RootfsPartA RootfsPartB"
# MENDER_ARTIFACT_EXTRA_ARGS:append = " -v 2"

# IMAGE_BOOT_FILES:append = " u-boot.env"

PREFERRED_VERSION_mender ?= "4.0.7"
```

## meta-mender-titanium/conf/machine/ni-titanium-mender.inc
```bitbake
MACHINEOVERRIDES =. "ni-titanium-mender:"

MENDER_FEATURES_ENABLE:append:ni-titanium-mender = " mender-uboot mender-image \
    mender-image-sd"
MENDER_FEATURES_DISABLE:append:ni-titanium-mender = " mender-grub mender-image-uefi"

IMAGE_INSTALL:append = " mender-migrate-configuration mender-is-mender-update"
PACKAGECONFIG:remove = "split-mender-config"
MENDER_PERSISTENT_CONFIGURATION_VARS = "RootfsPartA RootfsPartB"
# MENDER_ARTIFACT_EXTRA_ARGS:append = " -v 2"

MENDER_DATA_PART_FSTAB_OPTS ?= "defaults,noatime"
MENDER_BOOT_PART_FSTAB_OPTS ?= "defaults,noatime"

PREFERRED_VERSION_mender ?= "4.0.7"
```
