## meta-ettus-bsp/conf/layer.conf
```bitbake
# We have a conf and classes directory, add to BBPATH
BBPATH .= ":${LAYERDIR}"

# We have recipes-* directories, add to BBFILES
BBFILES += "${LAYERDIR}/recipes-*/*/*.bb \
            ${LAYERDIR}/recipes-*/*/*.bbappend \
            ${LAYERDIR}/meta/*.bb"

BBFILE_COLLECTIONS += "meta-ettus-bsp-layer"
BBFILE_PATTERN_meta-ettus-bsp-layer = "^${LAYERDIR}/"
BBFILE_PRIORITY_meta-ettus-bsp-layer = "6"

LAYERSERIES_COMPAT_meta-ettus-bsp-layer = "scarthgap"

BINARYDIR = "${LAYERDIR}/binary"

BBFILES_DYNAMIC += " \
xilinx:${LAYERDIR}/dynamic-layers/meta-xilinx-core/recipes-*/*/*.bb \
xilinx:${LAYERDIR}/dynamic-layers/meta-xilinx-core/recipes-*/*/*.bbappend \
xilinx-tools:${LAYERDIR}/dynamic-layers/meta-xilinx-tools/recipes-*/*/*.bb \
xilinx-tools:${LAYERDIR}/dynamic-layers/meta-xilinx-tools/recipes-*/*/*.bbappend \
"
```

## meta-ettus-bsp/conf/machine/ni-e31x.inc
```bitbake
#@TYPE: Machine
#@NAME: NI Ettus E31x machine
#@DESCRIPTION: USRP Embedded Series E31x, see https://www.ettus.com/product-categories/usrp-embedded-series/

require conf/machine/ni-zynq.inc

MACHINEOVERRIDES:append = ":ni-common:ni-e31x"

MACHINE_FEATURES = "vfat ethernet usbhost ext2 rtc"

EXTRA_IMAGEDEPENDS += "virtual/bootloader"
PREFERRED_PROVIDER_virtual/bootloader ?= "u-boot"
PREFERRED_VERSION_u-boot = "2019.07"

SPL_BINARY = "boot.bin"
UBOOT_SUFFIX = "img"
UBOOT_ENTRYPOINT = "0000000"
UBOOT_LOADADDRESS = "0000000"

KERNEL_CLASSES += "kernel-fitimage"
KERNEL_IMAGETYPE = "fitImage"
KERNEL_DEFCONFIG ?= "multi_v7_defconfig"
KERNEL_DEVICETREE = "${DTB_FILES}"
FIT_CONF_PREFIX = "conf@"

INITRAMFS_IMAGE = "manufacturing-image"
# INITRAMFS_IMAGE_BUNDLE = "1"

PREFERRED_VERSION_linux-yocto = "5.2.%"

MACHINE_ESSENTIAL_EXTRA_RDEPENDS += "kernel-image kernel-devicetree"

EXTRA_IMAGEDEPENDS += "u-boot"
IMAGE_BOOT_FILES ?= "u-boot.${UBOOT_SUFFIX} ${SPL_BINARY} ${KERNEL_IMAGETYPE}"

# On non-Mender devices, build "wic.xz" and "wic.bmap"
# On Mender enabled devices build "sdimg.bz2" (instead of "sdimg") and "sdimg.bmap"
IMAGE_FSTYPES += "${@bb.utils.contains('MENDER_FEATURES', 'mender-image-sd', ' sdimg.bz2', ' wic.xz wic.bmap', d)} tar.xz"
IMAGE_FSTYPES:remove = "${@bb.utils.contains('MENDER_FEATURES', 'mender-image-sd', ' sdimg', '', d)}"

WKS_FILE ?= "sdimage-minimal.wks"

MACHINE_EXTRA_RRECOMMENDS = " \
                             haveged \
                             util-linux-lsblk \
                             mpmd-tools \
                             eeprom-hostname-systemd \
                             gpsd-machine-conf \
                             udev-machine-conf \
                            "

# IMAGE_INSTALL:append = " \
#                              gpsd \
#                              "

do_image_wic[depends] += " \
    virtual/bootloader:do_deploy \
    "

SERIAL_CONSOLES ?= "115200;ttyPS0"
SERIAL_CONSOLES_CHECK = "${SERIAL_CONSOLES}"
```

## meta-ettus-bsp/conf/machine/ni-neon.inc
```bitbake
#@TYPE: Machine
#@NAME: NI Ettus E320 machine
#@DESCRIPTION: USRP Embedded Series E320, see https://www.ettus.com/product-categories/usrp-embedded-series/

require conf/machine/ni-zynq.inc

MACHINEOVERRIDES:append = ":ni-neon"

MACHINE_FEATURES = "vfat ethernet usbhost ext2 rtc"

EXTRA_IMAGEDEPENDS += "virtual/bootloader"
PREFERRED_PROVIDER_virtual/bootloader ?= "u-boot"
PREFERRED_VERSION_u-boot = "2019.07"

SPL_BINARY = "boot.bin"
UBOOT_SUFFIX = "img"
UBOOT_ENTRYPOINT = "0000000"
UBOOT_LOADADDRESS = "0000000"

KERNEL_CLASSES += "kernel-fitimage"
KERNEL_IMAGETYPE = "fitImage"
KERNEL_DEFCONFIG ?= "multi_v7_defconfig"
KERNEL_DEVICETREE = "${DTB_FILES}"
FIT_CONF_PREFIX = "conf@"

INITRAMFS_IMAGE = "manufacturing-image"
# INITRAMFS_IMAGE_BUNDLE = "1"

PREFERRED_VERSION_linux-yocto = "5.2.%"

MACHINE_ESSENTIAL_EXTRA_RDEPENDS += " \
                             kernel-image \
                             kernel-devicetree \
                             watchdog \
                             usrp-firmware \
                            "

EXTRA_IMAGEDEPENDS += "u-boot"
IMAGE_BOOT_FILES ?= "u-boot.${UBOOT_SUFFIX} ${SPL_BINARY} ${KERNEL_IMAGETYPE} ${KERNEL_DEVICETREE}"
IMAGE_FSTYPES += "${@bb.utils.contains('MENDER_FEATURES', 'mender-image-sd', '', ' wic.xz wic.bmap', d)} tar.xz"
WKS_FILE ?= "sdimage-minimal.wks"

MACHINE_EXTRA_RRECOMMENDS = " \
                             haveged \
                             util-linux-lsblk \
                             mpmd-tools \
                             eeprom-hostname-systemd \
                             gpsd-machine-conf \
                            "

# IMAGE_INSTALL:append:ni-neon = " kernel-image \
#                                 linux-firmware-ni-neon \
#                                 gpsd \
#                                "

do_image_wic[depends] += " \
    u-boot:do_deploy \
    "

SERIAL_CONSOLES ?= "115200;ttyPS0"
SERIAL_CONSOLES_CHECK = "${SERIAL_CONSOLES}"
```

## meta-ettus-bsp/conf/machine/ni-sulfur-rev5.conf
```bitbake
#@TYPE: Machine
#@Name: Ettus Research Sulfur.
#@DESCRIPTION: Machine configuration for the Ettus Research Sulfur Rev5 Software Radio.

require conf/machine/ni-sulfur.inc

DTB_FILES = "\
                                    zynq-ni-sulfur-rev3.dtb \
                                    zynq-ni-sulfur-rev4.dtb \
                                    zynq-ni-sulfur-rev5.dtb \
                                    zynq-ni-sulfur-rev3-eiscat-rev1.dtb \
                                    zynq-ni-sulfur-rev3-eiscat-rev2.dtb \
                                    zynq-ni-sulfur-rev4-magnesium-rev2.dtb \
                                    zynq-ni-sulfur-rev4-magnesium-rev3.dtb \
                                    zynq-ni-sulfur-rev5-magnesium-rev2.dtb \
                                    zynq-ni-sulfur-rev5-magnesium-rev3.dtb \
                                    zynq-ni-sulfur-rev4-rhodium-rev0.dtb \
                                    zynq-ni-sulfur-rev5-rhodium-rev0.dtb \
                                    zynq-ni-phosphorus-rev4.dtb \
                                    zynq-ni-phosphorus-rev4-magnesium-rev2.dtb \
                                    zynq-ni-phosphorus-rev4-magnesium-rev3.dtb \
                                    "
KERNEL_DEVICETREE = '${@' '.join('xilinx/%s' % d for d in '${DTB_FILES}'.split())}'
UBOOT_MACHINE = "ni_sulfur_rev3_defconfig"

MACHINE_FEATURES:append = " tpm"
```

## meta-ettus-bsp/conf/machine/ni-sulfur.inc
```bitbake
#@TYPE: Machine
#@NAME: NI Ettus N3xx machine
#@DESCRIPTION: USRP Networked Series N3xx, see https://www.ettus.com/product-categories/usrp-networked-series/

require conf/machine/ni-zynq.inc

MACHINEOVERRIDES:append = ":ni-sulfur"

MACHINE_FEATURES = "vfat ethernet usbhost ext2 rtc"

EXTRA_IMAGEDEPENDS += "virtual/bootloader"
PREFERRED_PROVIDER_virtual/bootloader ?= "u-boot"
PREFERRED_VERSION_u-boot = "2019.07"

SPL_BINARY = "boot.bin"
UBOOT_SUFFIX = "img"
UBOOT_ENTRYPOINT = "0000000"
UBOOT_LOADADDRESS = "0000000"

# UBOOT_BINARY:ni-sulfur = "u-boot.${UBOOT_SUFFIX}"
# SPL_BINARY:ni-sulfur = "spl/boot.bin"
# IMAGE_BOOT_FILES ?= "boot.bin ${UBOOT_BINARY}"

KERNEL_CLASSES += "kernel-fitimage"
KERNEL_IMAGETYPE = "fitImage"
KERNEL_DEFCONFIG ?= "ni_sulfur_defconfig"
KERNEL_DEVICETREE = "${DTB_FILES}"
FIT_CONF_PREFIX = "conf@ni_"

INITRAMFS_IMAGE = "manufacturing-image"
# INITRAMFS_IMAGE_BUNDLE = "1"

PREFERRED_VERSION_linux-yocto = "5.2.%"

MACHINE_ESSENTIAL_EXTRA_RDEPENDS += " \
                             kernel-image \
                             kernel-devicetree \
                             watchdog \
                             usrp-firmware \
                            "

EXTRA_IMAGEDEPENDS += "u-boot"
IMAGE_BOOT_FILES ?= "u-boot.${UBOOT_SUFFIX} ${SPL_BINARY} ${KERNEL_IMAGETYPE} ${KERNEL_DEVICETREE}"

# On non-Mender devices, build "wic.xz" and "wic.bmap"
# On Mender enabled devices build "sdimg.bz2" (instead of "sdimg") and "sdimg.bmap"
IMAGE_FSTYPES += "${@bb.utils.contains('MENDER_FEATURES', 'mender-image-sd', ' sdimg.bz2', ' wic.xz wic.bmap', d)} tar.xz"
IMAGE_FSTYPES:remove = "${@bb.utils.contains('MENDER_FEATURES', 'mender-image-sd', ' sdimg', '', d)}"

WKS_FILE ?= "sdimage-minimal.wks"

MACHINE_EXTRA_RRECOMMENDS = " \
                             haveged \
                             util-linux-lsblk \
                             mpmd-tools \
                             eeprom-hostname-systemd \
                             gpsd-machine-conf \
                             udev-machine-conf \
                            "

# IMAGE_INSTALL:append:ni-sulfur = " kernel-image \
#                                   linux-firmware-ni-sulfur \
#                                   linux-firmware-ni-magnesium \
#                                   linux-firmware-adi-mykonos \
#                                   linux-firmware-ni-rhodium \
#                                   gpsd \
# "

do_image_wic[depends] += " \
    u-boot:do_deploy \
    "

SERIAL_CONSOLES ?= "115200;ttyPS0"
SERIAL_CONSOLES_CHECK = "${SERIAL_CONSOLES}"
```

## meta-ettus-bsp/conf/machine/ni-titanium-rev2.conf
```bitbake
require ni-titanium.inc

UBOOT_MACHINE = "ni_x410_rev2_defconfig"

WKS_FILE ?= "ni-titanium-rev2.wks"
WKS_FILES ?= "${WKS_FILE}"

# include this after defining WKS_FILE
require conf/machine/ni-titanium-xlnx-${XILINX_XSCT_VERSION}.conf
```

## meta-ettus-bsp/conf/machine/ni-titanium-rev4.conf
```bitbake
require ni-titanium.inc

UBOOT_MACHINE = "ni_x410_rev4_defconfig"

WKS_FILE ?= "ni-titanium-rev4.wks"
WKS_FILES ?= "${WKS_FILE}"

# include this after defining WKS_FILE
require conf/machine/ni-titanium-xlnx-${XILINX_XSCT_VERSION}.conf
```

## meta-ettus-bsp/conf/machine/ni-titanium-rev5.conf
```bitbake
require ni-titanium.inc

UBOOT_MACHINE = "ni_x410_rev5_defconfig"

WKS_FILE ?= "ni-titanium-rev5.wks"
WKS_FILES ?= "${WKS_FILE}"

# include this after defining WKS_FILE
require conf/machine/ni-titanium-xlnx-${XILINX_XSCT_VERSION}.conf
```

## meta-ettus-bsp/conf/machine/ni-titanium-xlnx-2025.1.conf
```bitbake
#@TYPE: Machine
#@NAME: ni-titanium-xlnx
#@DESCRIPTION: Machine configuration for NI Titanium (X4XX MB).

#### Preamble
MACHINEOVERRIDES =. "${@['', 'ni-titanium:']['ni-titanium' !='${MACHINE}']}"
#### Regular settings follow

# Yocto device-tree variables
YAML_CONSOLE_DEVICE_CONFIG:pn-device-tree ?= "psu_uart_1"
YAML_MAIN_MEMORY_CONFIG:pn-device-tree ?= "psu_ddr_0"
DT_PADDING_SIZE:pn-device-tree ?= "0x1000"
DTC_FLAGS:pn-device-tree ?= ""

# Yocto u-boot-xlnx variables
UBOOT_MACHINE ?= "xilinx_zynqmp_virt_defconfig"

# Use uart 1 for XSCT based software (pmu-firmware, fsbl-firmware, ...)
YAML_SERIAL_CONSOLE_STDIN ?= "psu_uart_1"
YAML_SERIAL_CONSOLE_STDOUT ?= "psu_uart_1"

# Serial Console Settings
SERIAL_CONSOLES ?= "115200;ttyPS0"
YAML_SERIAL_CONSOLE_BAUDRATE ?= "115200"

# Yocto arm-trusted-firmware(TF-A) variables
TFA_CONSOLE ?= "cadence1"
TFA_BL33_LOAD ?= "0x8000000"

# Set DDR Base address for u-boot-xlnx-scr variables
DDR_BASEADDR ?= "0x0"
SKIP_APPEND_BASEADDR ?= "0"

# Yocto KERNEL Variables
UBOOT_ENTRYPOINT  ?= "0x200000"
UBOOT_LOADADDRESS ?= "0x200000"

# TODO: Check if any MACHINE_FEATURES need to be added
# Yocto MACHINE_FEATURES Variable
# MACHINE_FEATURES += "rfsoc"

# TODO: adopt for NI Titanium
# QB_MEM = "-m 4G"
# QEMU_HW_DTB_PS = "${QEMU_HW_DTB_PATH}/zcu102-arm.dtb"
# QEMU_HW_DTB_PMU = "${QEMU_HW_DTB_PATH}/zynqmp-pmu.dtb"

MACHINE_FEATURES_BACKFILL_CONSIDERED = "qemu-usermode"

# Required generic machine inclusion
require conf/machine/zynqmp-generic.conf

# This is an 'XSCT' based BSP
XILINX_XSCT_VERSION = "2025.1"
XILINX_WITH_ESW = "xsct"

# Note: variables HDF_BASE and HDF_PATH is defined in the external-hdf bbappend file

#### No additional settings should be after the Postamble
#### Postamble
PACKAGE_EXTRA_ARCHS:append = "${@['', ' ni-titanium']['ni-titanium' != '${MACHINE}']}"

PREFERRED_PROVIDER_virtual/boot-bin = "xilinx-bootbin"
PREFERRED_PROVIDER_virtual/bootloader = "u-boot"

PREFERRED_PROVIDER_u-boot-tools = "u-boot-tools"
PREFERRED_PROVIDER_u-boot-tools-native = "u-boot-tools-native"


UBOOT_SUFFIX:zynqmp ?= "itb"
UBOOT_BINARY ?= "u-boot.${UBOOT_SUFFIX}"
UBOOT_ELF:aarch64 ?= "u-boot.elf"
UBOOT_MACHINE = "ni_x410_rev5_defconfig"

BIF_COMMON_ATTR="${@'auth_params pskfile sskfile' if d.getVar('BOOTGEN_KEYS_PATH') else ''}"
BIF_COMMON_ATTR[auth_params] ?= "ppk_select = 0; spk_id=0x00000000"
BIF_COMMON_ATTR[pskfile] ?= "psk0.pem"
BIF_COMMON_ATTR[sskfile] ?= "ssk0.pem"
BIF_AUTHENTICATION ?= "${@',authentication=rsa' if d.getVar('BOOTGEN_KEYS_PATH') else ''}"

BIF_PARTITION_ATTR ?= "fsbl pmufw arm-trusted-firmware device-tree u-boot"
BIF_PARTITION_ATTR[fsbl] ?= "bootloader,destination_cpu=a53-0${BIF_AUTHENTICATION}"
BIF_PARTITION_ATTR[pmufw] ?= "destination_cpu=pmu${BIF_AUTHENTICATION}"
BIF_PARTITION_ATTR[arm-trusted-firmware] ?= "destination_cpu=a53-0, exception_level=el-3,trustzone${BIF_AUTHENTICATION}"
BIF_PARTITION_ATTR[device-tree] ?= "destination_cpu=a53-0, load=0x100000${BIF_AUTHENTICATION}"
BIF_PARTITION_ATTR[u-boot] ?= "destination_cpu=a53-0, exception_level=el-1${BIF_AUTHENTICATION}"
BIF_PARTITION_IMAGE[u-boot] ?= "${RECIPE_SYSROOT}/uboot/u-boot.elf"

# TODO: revisit DTB handling
IMAGE_BOOT_FILES:remove = "system.dtb"
# Image is appended by conf/machine/zynqmp-generic.conf
IMAGE_BOOT_FILES:remove = "Image"
IMAGE_BOOT_FILES += " fitImage"

# TODO: revisit boot script handling
# UBOOT_BOOT_SCRIPT = ""

# Consume u-boot instead of u-boot-xlnx in xilinx-bootbin recipe
BIF_SSBL_ATTR = "u-boot"
```
