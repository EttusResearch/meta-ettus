/*
 * Ettus E200 DTS file header for sdcard/mmc partition 2 boot.
 */

/dts-v1/;
/include/ "ettus-e300.dtsi"
/ {
	chosen {
		bootargs = "console=ttyPS0,115200 root=/dev/mmcblk0p2 ro rootwait earlyprintk";
	} ;
} ;
