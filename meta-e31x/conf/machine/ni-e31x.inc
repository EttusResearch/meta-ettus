## meta-e31x/conf/machine/ni-e31x.inc
```bitbake
require conf/machine/ni-zynq.inc

MACHINEOVERRIDES = "ni-e31x:${MACHINE}"

MACHINE_FEATURES = "vfat ethernet usbhost ext2 rtc"

SERIAL_CONSOLES ?= "115200;ttyPS0"
SERIAL_CONSOLES_CHECK = "${SERIAL_CONSOLES}"

UBOOT_SUFFIX_ni-e31x = "img"
UBOOT_ENTRYPOINT_ni-e31x = "0000000"
UBOOT_LOADADDRESS_ni-e31x = "0000000"
UBOOT_BINARY_ni-e31x = "u-boot.${UBOOT_SUFFIX}"
SPL_BINARY_ni-e31x = "spl/boot.bin"

PREFERRED_VERSION_u-boot = "2019.07"

IMAGE_BOOT_FILES ?= "boot.bin ${UBOOT_BINARY}"

KERNEL_CLASSES += "kernel-fitimage"
KERNEL_IMAGETYPE = "fitImage"
KERNEL_DEFCONFIG ?= "multi_v7_defconfig"

PREFERRED_VERSION_linux-yocto = "4.18.%"

MACHINE_ESSENTIAL_EXTRA_RRECOMMENDS = " \
                             kernel-image \
                             kernel-modules \
                            "

MACHINE_EXTRA_RRECOMMENDS = " \
                             eeprom-hostname-systemd \
                             gpsd \
                             gpsd-gpsctl \
                             gpsd-machine-conf \
                             haveged \
                            "

IMAGE_INSTALL_append_ni-e31x = " kernel-image"
```

## meta-ettus-core/conf/layer.conf
```bitbake
# We have a conf and classes directory, add to BBPATH
BBPATH .= ":${LAYERDIR}"

# We have recipes-* directories, add to BBFILES
BBFILES += "${LAYERDIR}/recipes-*/*/*.bb \
            ${LAYERDIR}/recipes-*/*/*.bbappend"

BBFILE_COLLECTIONS += "meta-ettus-core-layer"
BBFILE_PATTERN_meta-ettus-core-layer = "^${LAYERDIR}/"
BBFILE_PRIORITY_meta-ettus-core-layer = "6"

LAYERSERIES_COMPAT_meta-ettus-core-layer = "zeus"
```

## meta-ettus-core/conf/machine/ni-zynq.inc
```bitbake
#@TYPE: Machine
#@DESCRIPTION: Base configuration for the Ettus Research Zynq based products.

PREFERRED_PROVIDER_virtual/kernel ?= "linux-yocto"

include conf/machine/include/tune-zynq.inc

PREFERRED_PROVIDER_virtual/bootloader ?= "u-boot"
```

## meta-ettus-core/conf/machine/ni-zynqmp.inc
```bitbake
#@TYPE: Machine
#@DESCRIPTION: Base configuration for the Ettus Research Zynq based products.

PREFERRED_PROVIDER_virtual/kernel ?= "linux-yocto"

include conf/machine/include/tune-zynqmp.inc

PREFERRED_PROVIDER_virtual/bootloader ?= "u-boot"
```

## meta-mender-e31x/conf/machine/ni-e31x-mender.inc
```bitbake
MACHINEOVERRIDES =. "ni-e31x-mender:"

# 8GB SD card with some wiggle room for smaller cards
MENDER_STORAGE_TOTAL_SIZE_MB = "7372"
MENDER_DATA_PART_SIZE_MB = "2000"
MENDER_BOOT_PART_SIZE_MB = "16"
MENDER_STORAGE_DEVICE = "/dev/mmcblk0"

MENDER_FEATURES_ENABLE_append_ni-e31x-mender = " mender-uboot mender-image mender-systemd mender-image-sd"
MENDER_FEATURES_DISABLE_append_ni-e31x-mender = " mender-grub mender-image-uefi"

PREFERRED_VERSION_pn-mender-client = "2.%"
PREFERRED_VERSION_pn-mender-artifact = "3.%"
PREFERRED_VERSION_pn-mender-artifact-native = "3.%"

IMAGE_INSTALL_append = " mender-client-migrate-configuration"
PACKAGECONFIG_remove = "split-mender-config"
MENDER_PERSISTENT_CONFIGURATION_VARS = "RootfsPartA RootfsPartB"
MENDER_ARTIFACT_EXTRA_ARGS_append = " -v 2"
```

## meta-mender-e31x/conf/machine/ni-e31x-sg1-mender.conf
```bitbake
#@TYPE: Machine
#@Name: Ettus Research E310 SG1 with Mender Integration.
#@DESCRIPTION: Machine configuration for the Ettus Research E310 SG1 Software Radio with Mender Integration

require conf/machine/ni-e31x-sg1.conf
require conf/machine/ni-e31x-mender.inc

MACHINEOVERRIDES =. "ni-e31x-sg1:"
```

## meta-mender-e31x/conf/machine/ni-e31x-sg3-mender.conf
```bitbake
#@TYPE: Machine
#@Name: Ettus Research E310 SG3 with Mender Integration.
#@DESCRIPTION: Machine configuration for the Ettus Research E310 SG3 Software Radio with Mender Integration

require conf/machine/ni-e31x-sg3.conf
require conf/machine/ni-e31x-mender.inc

MACHINEOVERRIDES =. "ni-e31x-sg3:"
```

## meta-mender-neon/conf/layer.conf
```bitbake
# We have a conf and classes directory, add to BBPATH
BBPATH .= ":${LAYERDIR}"

# We have recipes-* directories, add to BBFILES
BBFILES += "${LAYERDIR}/recipes-*/*/*.bb \
            ${LAYERDIR}/recipes-*/*/*.bbappend"

BBFILE_COLLECTIONS += "meta-mender-neon-layer"
BBFILE_PATTERN_meta-mender-neon-layer = "^${LAYERDIR}/"
BBFILE_PRIORITY_meta-mender-neon-layer = "6"

LAYERSERIES_COMPAT_meta-mender-neon-layer = "thud"
```

## meta-mender-neon/conf/machine/ni-neon-mender.inc
```bitbake
MACHINEOVERRIDES =. "ni-neon-mender:"

# Stay within 16GB of SD Card
MENDER_STORAGE_TOTAL_SIZE_MB ?= "15180"
MENDER_DATA_PART_SIZE_MB ?= "11196"
MENDER_BOOT_PART_SIZE_MB ?= "16"
MENDER_STORAGE_DEVICE = "/dev/mmcblk0"

# force a fixed partitioning (Mender default values as of OE sumo release)
MENDER_PARTITIONING_OVERHEAD_KB ?= "32768"
MENDER_PARTITION_ALIGNMENT ?= "8388608"
MENDER_RESERVED_SPACE_BOOTLOADER_DATA ?= "16777216"

MENDER_FEATURES_ENABLE_append_ni-neon-mender = " mender-uboot mender-image mender-systemd mender-image-sd"
MENDER_FEATURES_DISABLE_append_ni-neon-mender = " mender-grub mender-image-uefi"

PREFERRED_VERSION_pn-mender-client = "2.%"
PREFERRED_VERSION_pn-mender-artifact = "3.%"
PREFERRED_VERSION_pn-mender-artifact-native = "3.%"

IMAGE_INSTALL_append = " mender-client-migrate-configuration"
PACKAGECONFIG_remove = "split-mender-config"
MENDER_PERSISTENT_CONFIGURATION_VARS = "RootfsPartA RootfsPartB"
MENDER_ARTIFACT_EXTRA_ARGS_append = " -v 2"
```

## meta-mender-neon/conf/machine/ni-neon-rev1-mender.conf
```bitbake
require conf/machine/ni-neon-rev1.conf
require conf/machine/ni-neon-mender.inc

MACHINEOVERRIDES =. "ni-neon-rev1:"
```

## meta-mender-neon/conf/machine/ni-neon-rev2-mender.conf
```bitbake
require conf/machine/ni-neon-rev2.conf
require conf/machine/ni-neon-mender.inc

MACHINEOVERRIDES =. "ni-neon-rev2:"
```

## meta-mender-sulfur/conf/layer.conf
```bitbake
# We have a conf and classes directory, add to BBPATH
BBPATH .= ":${LAYERDIR}"

# We have recipes-* directories, add to BBFILES
BBFILES += "${LAYERDIR}/recipes-*/*/*.bb \
            ${LAYERDIR}/recipes-*/*/*.bbappend"

BBFILE_COLLECTIONS += "meta-mender-sulfur"
BBFILE_PATTERN_meta-mender-sulfur = "^${LAYERDIR}/"
BBFILE_PRIORITY_meta-mender-sulfur = "6"
```

## meta-mender-sulfur/conf/machine/ni-sulfur-rev3-mender.conf
```bitbake
#@TYPE: Machine
#@Name: Ettus Research Sulfur Revision 3 with Mender Integration.
#@DESCRIPTION: Machine configuration for the Ettus Research Sulfur Rev3 Software Radio with Mender Integration

require conf/machine/ni-sulfur-rev3.conf
require conf/machine/ni-sulfur-mender.inc

MENDER_DEVICE_TYPES_COMPATIBLE = " \
                                 ni-sulfur-rev3-mender \
                                 ni-sulfur-rev3 \
                                 "
```

## meta-mender-sulfur/conf/machine/ni-sulfur-rev4-mender.conf
```bitbake
#@TYPE: Machine
#@Name: Ettus Research Sulfur Revision 4 with Mender Integration.
#@DESCRIPTION: Machine configuration for the Ettus Research Sulfur Rev4 Software Radio with Mender Integration

require conf/machine/ni-sulfur-rev4.conf
require conf/machine/ni-sulfur-mender.inc

MENDER_DEVICE_TYPES_COMPATIBLE = " \
                                 ni-sulfur-rev4-mender \
                                 ni-sulfur-rev3-mender \
                                 ni-sulfur-rev4 \
                                 ni-sulfur-rev3 \
                                 "
```

## meta-mender-sulfur/conf/machine/ni-sulfur-rev5-mender.conf
```bitbake
#@TYPE: Machine
#@Name: Ettus Research Sulfur Revision 5 with Mender Integration.
#@DESCRIPTION: Machine configuration for the Ettus Research Sulfur Rev5 Software Radio with Mender Integration

require conf/machine/ni-sulfur-rev5.conf
require conf/machine/ni-sulfur-mender.inc

MACHINEOVERRIDES =. "ni-sulfur-rev5:"

MENDER_DEVICE_TYPES_COMPATIBLE = " \
                                 ni-sulfur-rev6-mender \
                                 ni-sulfur-rev5-mender \
                                 ni-sulfur-rev4-mender \
                                 ni-sulfur-rev3-mender \
                                 ni-sulfur-rev6 \
                                 ni-sulfur-rev5 \
                                 ni-sulfur-rev4 \
                                 ni-sulfur-rev3 \
                                 "
```

## meta-mender-sulfur/conf/machine/ni-sulfur-rev6-mender.conf
```bitbake
#@TYPE: Machine
#@Name: Ettus Research Sulfur Revision 6+ (currently up to rev. 10) with Mender Integration.
#@DESCRIPTION: Machine configuration for the Ettus Research Sulfur Rev6 Software Radio with Mender Integration

# Note: machine "ni-sulfur-rev6-mender" can also be used for newer versions on n310 motherboard
# ("sulfur") or n300 motherboard ("phosphorus") if the only change is an updated MCU
# firmware. The "dt_compat" ("devicetree compatible") number stored in the eeprom is
# used to generate the string "variant" in u-boot which selects the device tree that
# is used to boot the device. "dt_compat" can be a smaller number than the current
# hardware revision if the device tree is compatible.

require conf/machine/ni-sulfur-rev6.conf
require conf/machine/ni-sulfur-mender.inc

MENDER_DEVICE_TYPES_COMPATIBLE = " \
                                 ni-sulfur-rev6-mender \
                                 ni-sulfur-rev5-mender \
                                 ni-sulfur-rev4-mender \
                                 ni-sulfur-rev3-mender \
                                 ni-sulfur-rev6 \
                                 ni-sulfur-rev5 \
                                 ni-sulfur-rev4 \
                                 ni-sulfur-rev3 \
                                 "
```

## meta-mender-titanium/conf/bblayers.conf.sample
```bitbake
# LAYER_CONF_VERSION is increased each time build/conf/bblayers.conf
# changes incompatibly
LCONF_VERSION = "7"

BBPATH = "${TOPDIR}"
BBFILES ?= ""

BBLAYERS ?= " \
  ##OEROOT##/meta \
  ##OEROOT##/../meta-oe/meta-oe \
  ##OEROOT##/../meta-oe/meta-filesystems \
  ##OEROOT##/../meta-oe/meta-networking \
  ##OEROOT##/../meta-oe/meta-python \
  ##OEROOT##/../meta-xilinx/meta-xilinx-bsp \
  ##OEROOT##/../meta-xilinx/meta-xilinx-standalone \
  ##OEROOT##/../meta-security/meta-tpm \
  ##OEROOT##/../meta-mender/meta-mender-core \
  ##OEROOT##/../meta-openamp \
  ##OEROOT##/../meta-stm32 \
  ##OEROOT##/../meta-ettus/meta-ettus-core \
  ##OEROOT##/../meta-ettus/meta-alchemy \
  ##OEROOT##/../meta-ettus/meta-titanium \
  ##OEROOT##/../meta-ettus/meta-mender-titanium \
  "
```

## meta-mender-titanium/conf/layer.conf
```bitbake
# We have a conf and classes directory, add to BBPATH
BBPATH .= ":${LAYERDIR}"

# We have recipes-* directories, add to BBFILES
BBFILES += "${LAYERDIR}/recipes-*/*/*.bb \
            ${LAYERDIR}/recipes-*/*/*.bbappend"

BBFILE_COLLECTIONS += "meta-mender-titanium-layer"
BBFILE_PATTERN_meta-mender-titanium-layer = "^${LAYERDIR}/"
BBFILE_PRIORITY_meta-mender-titanium-layer = "9"

LAYERSERIES_COMPAT_meta-mender-titanium-layer = "zeus"
```

## meta-mender-titanium/conf/local.conf.sample
```bitbake
BBMULTICONFIG = "ni-titanium-ec zynqmp-pmu ni-titanium"
MACHINE ??= "ni-titanium-rev2-mender"
DISTRO = "Alchemy"
INHERIT_remove = "uninative"
```

## meta-mender-titanium/conf/machine/ni-titanium-rev2-mender.conf
```bitbake
#@TYPE: Machine
#@Name: National Instruments Titanium Rev2 with Mender Integration.
#@DESCRIPTION: Machine configuration for the National Instruments Titanium Rev2 with Mender Integration.

require conf/machine/ni-titanium-rev2.conf
require conf/machine/ni-titanium-mender.inc

MACHINEOVERRIDES =. "ni-titanium-rev2:"

MENDER_DEVICE_TYPES_COMPATIBLE = " \
                                 ni-titanium-rev2-mender \
                                 ni-titanium-rev2 \
                                 "
MENDER_STORAGE_DEVICE = "/dev/mmcblk0"
MENDER_STORAGE_TOTAL_SIZE_MB ?= "3670"
MENDER_DATA_PART_SIZE_MB ?= "128"
MENDER_BOOT_PART_SIZE_MB ?= "16"

# not really used, only for silencing the warning from task
# do_provide_mender_defines when building the kernel
MENDER_DTB_NAME_FORCE = "ni/x410-rev2.dtb"
```

## meta-mender-titanium/conf/machine/ni-titanium-rev3-mender.conf
```bitbake
#@TYPE: Machine
#@Name: National Instruments Titanium Rev3 with Mender Integration.
#@DESCRIPTION: Machine configuration for the National Instruments Titanium Rev3 with Mender Integration.

require conf/machine/ni-titanium-rev3.conf
require conf/machine/ni-titanium-mender.inc

MACHINEOVERRIDES =. "ni-titanium-rev3:"

MENDER_DEVICE_TYPES_COMPATIBLE = " \
                                 ni-titanium-rev3-mender \
                                 ni-titanium-rev3 \
                                 "
MENDER_STORAGE_DEVICE = "/dev/mmcblk1"
MENDER_STORAGE_TOTAL_SIZE_MB ?= "30328"
MENDER_DATA_PART_SIZE_MB ?= "15132"
MENDER_BOOT_PART_SIZE_MB ?= "16"

# not really used, only for silencing the warning from task
# do_provide_mender_defines when building the kernel
MENDER_DTB_NAME_FORCE = "ni/x410-rev3.dtb"
```

## meta-mender-titanium/conf/machine/ni-titanium-rev4-mender.conf
```bitbake
#@TYPE: Machine
#@Name: National Instruments Titanium Rev4 with Mender Integration.
#@DESCRIPTION: Machine configuration for the National Instruments Titanium Rev4 with Mender Integration.

require conf/machine/ni-titanium-rev4.conf
require conf/machine/ni-titanium-mender.inc

MACHINEOVERRIDES =. "ni-titanium-rev4:"

MENDER_DEVICE_TYPES_COMPATIBLE = " \
                                 ni-titanium-rev4-mender \
                                 ni-titanium-rev4 \
                                 "
MENDER_STORAGE_DEVICE = "/dev/mmcblk0"
MENDER_STORAGE_TOTAL_SIZE_MB ?= "30328"
MENDER_DATA_PART_SIZE_MB ?= "15132"
MENDER_BOOT_PART_SIZE_MB ?= "16"

# not really used, only for silencing the warning from task
# do_provide_mender_defines when building the kernel
MENDER_DTB_NAME_FORCE = "ni/x410-rev4.dtb"
```

## meta-mender-titanium/conf/machine/ni-titanium-rev5-mender.conf
```bitbake
#@TYPE: Machine
#@Name: National Instruments Titanium Rev5 with Mender Integration.
#@DESCRIPTION: Machine configuration for the National Instruments Titanium Rev5 with Mender Integration.

require conf/machine/ni-titanium-rev5.conf
require conf/machine/ni-titanium-mender.inc

MACHINEOVERRIDES =. "ni-titanium-rev5:"

MENDER_DEVICE_TYPES_COMPATIBLE = " \
                                 ni-titanium-rev4-mender \
                                 ni-titanium-rev4 \
                                 ni-titanium-rev5-mender \
                                 ni-titanium-rev5 \
                                 "
MENDER_STORAGE_DEVICE = "/dev/mmcblk0"
MENDER_STORAGE_TOTAL_SIZE_MB ?= "15104"
MENDER_DATA_PART_SIZE_MB ?= "7520"
MENDER_BOOT_PART_SIZE_MB ?= "16"

# not really used, only for silencing the warning from task
# do_provide_mender_defines when building the kernel
MENDER_DTB_NAME_FORCE = "ni/x410-rev5.dtb"
```

## meta-neon/conf/layer.conf
```bitbake
# We have a conf and classes directory, add to BBPATH
BBPATH .= ":${LAYERDIR}"

# We have recipes-* directories, add to BBFILES
BBFILES += "${LAYERDIR}/recipes-*/*/*.bb \
            ${LAYERDIR}/recipes-*/*/*.bbappend"

BBFILE_COLLECTIONS += "meta-neon-layer"
BBFILE_PATTERN_meta-neon-layer = "^${LAYERDIR}/"
BBFILE_PRIORITY_meta-neon-layer = "9"

LAYERSERIES_COMPAT_meta-neon-layer = "thud"
```

## meta-neon/conf/machine/ni-neon-rev1.conf
```bitbake
#@TYPE: Machine
#@Name: Ettus Research Neon.
#@DESCRIPTION: Machine configuration for the Ettus Research Neon Rev1 Software Radio.

require conf/machine/ni-neon.inc

KERNEL_DEVICETREE_ni-neon-rev1 = "\
                                  zynq-ni-neon-rev1.dtb \
                                 "


PREFERRED_VERSION_u-boot = "2018.01"
UBOOT_MACHINE_ni-neon-rev1 = "ni_neon_rev1_defconfig"

MACHINE_FEATURES_append_ni-neon-rev1 = " tpm"
```
